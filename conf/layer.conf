## conf/layer.conf
```bitbake
# We have a conf and classes directory, add to BBPATH
BBPATH .= ":${LAYERDIR}"

# We have recipes-* directories, add to BBFILES
BBFILES += "${LAYERDIR}/recipes-*/*/*.bb \
            ${LAYERDIR}/recipes-*/*/*.bbappend"

BBFILE_COLLECTIONS += "meta-tasks"
BBFILE_PATTERN_meta-tasks = "^${LAYERDIR}/"
BBFILE_PRIORITY_meta-tasks = "6"

LAYERDEPENDS_meta-tasks = "core"
LAYERSERIES_COMPAT_meta-tasks = "scarthgap"
```
